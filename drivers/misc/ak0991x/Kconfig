## drivers/misc/ak0991x/Kconfig
```kconfig
config SENSORS_AK0991x
       tristate "AK0991x compass support"
       default n
       depends on I2C
       help
         If you say yes here you get support for newer Asahi Kasei's
         orientation sensor AK0991x.
```
